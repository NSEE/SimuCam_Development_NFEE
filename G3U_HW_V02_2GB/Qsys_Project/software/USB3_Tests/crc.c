/* BoF */
/*
crc.c
Created on: 06/11/2017
Author:  Thiago Pereira Ricciardi
*/

#include "crc.h"

// CRC8 previously calculated table
#ifdef PROGMEM
const PROGMEM unsigned char crc8_table[] =
#else
static const unsigned char crc8_table[] =
#endif
{
	0x00, 0x07, 0x0e, 0x09, 0x1c, 0x1b, 0x12, 0x15, 0x38, 0x3f, 0x36, 0x31, 0x24, 0x23, 0x2a, 0x2d,
	0x70, 0x77, 0x7e, 0x79, 0x6c, 0x6b, 0x62, 0x65, 0x48, 0x4f, 0x46, 0x41, 0x54, 0x53, 0x5a, 0x5d,
	0xe0, 0xe7, 0xee, 0xe9, 0xfc, 0xfb, 0xf2, 0xf5, 0xd8, 0xdf, 0xd6, 0xd1, 0xc4, 0xc3, 0xca, 0xcd,
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	0xde, 0xd9, 0xd0, 0xd7, 0xc2, 0xc5, 0xcc, 0xcb, 0xe6, 0xe1, 0xe8, 0xef, 0xfa, 0xfd, 0xf4, 0xf3
};

// CRC8/KOOP previously calculated table
#ifdef PROGMEM
const PROGMEM unsigned char crc8_koop_table[] =
#else
static const unsigned char crc8_koop_table[] =
#endif
{
	0xea, 0xd4, 0x96, 0xa8, 0x12, 0x2c, 0x6e, 0x50, 0x7f, 0x41, 0x03, 0x3d, 0x87, 0xb9, 0xfb, 0xc5,
	0xa5, 0x9b, 0xd9, 0xe7, 0x5d, 0x63, 0x21, 0x1f, 0x30, 0x0e, 0x4c, 0x72, 0xc8, 0xf6, 0xb4, 0x8a,
	0x74, 0x4a, 0x08, 0x36, 0x8c, 0xb2, 0xf0, 0xce, 0xe1, 0xdf, 0x9d, 0xa3, 0x19, 0x27, 0x65, 0x5b,
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	0xd0, 0xee, 0xac, 0x92, 0x28, 0x16, 0x54, 0x6a, 0x45, 0x7b, 0x39, 0x07, 0xbd, 0x83, 0xc1, 0xff
};

// CRC16 previously calculated table
#ifdef PROGMEM
const PROGMEM unsigned short crc16_table[] =
#else
static const unsigned short crc16_table[] =
#endif
{
	0x00,   0xc0c1, 0xc181, 0x140,  0xc301, 0x3c0,  0x280,  0xc241, 0xc601, 0x6c0,  0x780,  0xc741, 0x500,  0xc5c1, 0xc481, 0x440,
	0xcc01, 0xcc0,  0xd80,  0xcd41, 0xf00,  0xcfc1, 0xce81, 0xe40,  0xa00,  0xcac1, 0xcb81, 0xb40,  0xc901, 0x9c0,  0x880,  0xc841,
	0xd801, 0x18c0, 0x1980, 0xd941, 0x1b00, 0xdbc1, 0xda81, 0x1a40, 0x1e00, 0xdec1, 0xdf81, 0x1f40, 0xdd01, 0x1dc0, 0x1c80, 0xdc41,
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	0x4400, 0x84c1, 0x8581, 0x4540, 0x8701, 0x47c0, 0x4680, 0x8641, 0x8201, 0x42c0, 0x4380, 0x8341, 0x4100, 0x81c1, 0x8081, 0x4040
};

// CRC16-CCITT previously calculated table
#ifdef PROGMEM
const PROGMEM unsigned short crc16_ccitt_table[] =
#else
static const unsigned short crc16_ccitt_table[] =
#endif
{
	0x00,   0x1021, 0x2042, 0x3063, 0x4084, 0x50a5, 0x60c6, 0x70e7, 0x8108, 0x9129, 0xa14a, 0xb16b, 0xc18c, 0xd1ad, 0xe1ce, 0xf1ef,
	0x1231, 0x210,  0x3273, 0x2252, 0x52b5, 0x4294, 0x72f7, 0x62d6, 0x9339, 0x8318, 0xb37b, 0xa35a, 0xd3bd, 0xc39c, 0xf3ff, 0xe3de,
	0x2462, 0x3443, 0x420,  0x1401, 0x64e6, 0x74c7, 0x44a4, 0x5485, 0xa56a, 0xb54b, 0x8528, 0x9509, 0xe5ee, 0xf5cf, 0xc5ac, 0xd58d,
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	0xef1f, 0xff3e, 0xcf5d, 0xdf7c, 0xaf9b, 0xbfba, 0x8fd9, 0x9ff8, 0x6e17, 0x7e36, 0x4e55, 0x5e74, 0x2e93, 0x3eb2, 0xed1,  0x1ef0
};

// CRC32 previously calculated table
#ifdef PROGMEM
const PROGMEM unsigned long crc32_table[] =
#else
static const unsigned long crc32_table[] =
#endif
{
	0x00,       0x77073096, 0xee0e612c, 0x990951ba, 0x76dc419,  0x706af48f, 0xe963a535, 0x9e6495a3, 0xedb8832,  0x79dcb8a4, 0xe0d5e91e, 0x97d2d988, 0x9b64c2b,  0x7eb17cbd, 0xe7b82d07, 0x90bf1d91,
	0x1db71064, 0x6ab020f2, 0xf3b97148, 0x84be41de, 0x1adad47d, 0x6ddde4eb, 0xf4d4b551, 0x83d385c7, 0x136c9856, 0x646ba8c0, 0xfd62f97a, 0x8a65c9ec, 0x14015c4f, 0x63066cd9, 0xfa0f3d63, 0x8d080df5,
	0x3b6e20c8, 0x4c69105e, 0xd56041e4, 0xa2677172, 0x3c03e4d1, 0x4b04d447, 0xd20d85fd, 0xa50ab56b, 0x35b5a8fa, 0x42b2986c, 0xdbbbc9d6, 0xacbcf940, 0x32d86ce3, 0x45df5c75, 0xdcd60dcf, 0xabd13d59,
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	0xbdbdf21c, 0xcabac28a, 0x53b39330, 0x24b4a3a6, 0xbad03605, 0xcdd70693, 0x54de5729, 0x23d967bf, 0xb3667a2e, 0xc4614ab8, 0x5d681b02, 0x2a6f2b94, 0xb40bbe37, 0xc30c8ea1, 0x5a05df1b, 0x2d02ef8d
};


/**
 * \brief Updates CRC8 check from a previously calculated CRC8
 *
 * \param crc8 previous CRC8
 * \param value value to be added to CRC8
 *
 * \return unsigned char a new CRC8 considering the value
 */
unsigned char crc__CRC8U(unsigned char crc8, unsigned char value)
{
	#ifdef pgm_read_byte
	return pgm_read_byte(crc8_table + (crc8 ^ value));
	#else
	return crc8_table[crc8 ^ value];
	#endif
}

/**
 * \brief Calculate CRC8 check for the data
 *
 * \param data data to calculate CRC8
 * \param length length of data
 *
 * \return unsigned char CRC8 for data
 */
unsigned char crc__CRC8(unsigned char const data[], unsigned long length)
{
	unsigned char crc = CRC_START_8;
	for (unsigned long a = 0; a < length; a++)
	{
		crc = crc__CRC8U(crc, data[a]);
	}
	return crc;
}


/**
 * \brief Updates CRC8/KOOP check from a previously calculated CRC8
 *
 * \param crc8koop previous CRC8/KOOP
 * \param value value to be added to CRC8/KOOP
 *
 * \return unsigned char a new CRC8/KOOP considering the value
 */
unsigned char crc__CRC8KOOPU(unsigned char crc8koop, unsigned char value)
{
	#ifdef pgm_read_byte
	return pgm_read_byte(crc8_koop_table + (crc8koop ^ value));
	#else
	return crc8_koop_table[crc8koop ^ value];
	#endif
}

/**
 * \brief Calculate CRC8/KOOP check for the data
 *
 * \param data data to calculate CRC8/KOOP
 * \param length length of data
 *
 * \return unsigned char CRC8/KOOP for data
 */
unsigned char crc__CRC8KOOP(unsigned char const data[], unsigned long length)
{
	unsigned char crc = CRC_START_8_KOOP;
	for (unsigned long a = 0; a < length; a++)
	{
		crc = crc__CRC8KOOPU(crc, data[a]);
	}
	return crc;
}


/**
 * \brief Updates CRC16 check from a previously calculated CRC16
 *
 * \param crc16 previous CRC16
 * \param value value to be added to CRC16
 *
 * \return unsigned short a new CRC16 considering the value
 */
unsigned short crc__CRC16U(unsigned short crc16, unsigned char value)
{
	#ifdef pgm_read_word
	return (unsigned short) ( (crc16 >> 8) ^ pgm_read_word(crc16_table + ((crc16 ^ value) & 0x00FF)) );
	#else
	return (unsigned short) ( (crc16 >> 8) ^ crc16_table[(crc16 ^ value) & 0x00FF] );
	#endif
}

/**
 * \brief Calculate CRC16 check for the data
 *
 * \param data data to calculate CRC16
 * \param length length of data
 *
 * \return unsigned short CRC16 for data
 */
unsigned short crc__CRC16(unsigned char const data[], unsigned long length)
{
	unsigned short crc = CRC_START_16;
	for (unsigned long a = 0; a < length; a++)
	{
		crc = crc__CRC16U(crc, data[a]);
	}
	return crc;
}


/**
 * \brief Updates CRC16-CCITT check from a previously calculated CRC16-CCITT
 *
 * \param crc16ccitt previous CRC16-CCITT
 * \param value value to be added to CRC16-CCITT
 *
 * \return unsigned short a new CRC16-CCITT considering the value
 */
unsigned short crc__CRC16CCITTU(unsigned short crc16ccitt, unsigned char value)
{
	#ifdef pgm_read_word
	return (unsigned short) ( ((crc16ccitt << 8) & 0xFF00) ^ pgm_read_word(crc16_ccitt_table + ((crc16ccitt >> 8) ^ value) & 0x00FF) );
	#else
	return (unsigned short) ( ((crc16ccitt << 8) & 0xFF00) ^ crc16_ccitt_table[((crc16ccitt >> 8) ^ value) & 0x00FF]);
	#endif
}

/**
 * \brief Calculate CRC16-CCITT check for the data
 *
 * \param data data to calculate CRC16-CCITT
 * \param length length of data
 *
 * \return unsigned short CRC16-CCITT for data
 */
unsigned short crc__CRC16CCITT(unsigned char const data[], unsigned long length)
{
	unsigned short crc = CRC_START_16_CCITT;
	for (unsigned long a = 0; a < length; a++)
	{
		crc = crc__CRC16CCITTU(crc, data[a]);
	}
	return crc;
}


/**
 * \brief Updates CRC32 check from a previously calculated CRC32
 *
 * \param crc32 previous CRC32
 * \param value value to be added to CRC32
 *
 * \return unsigned long a new CRC32 considering the value
 */
unsigned long crc__CRC32U(unsigned long crc32, unsigned char value)
{
	#ifdef pgm_read_dword
	return (crc32 >> 8) ^ pgm_read_dword(crc32_table + ((crc32 ^ value) & 0x000000FF));
	#else
	return (crc32 >> 8) ^ crc32_table[(crc32 ^ value) & 0x000000FF];
	#endif
}

/**
 * \brief Calculate CRC32 check for the data
 *
 * \param data data to calculate CRC32
 * \param length length of data
 *
 * \return unsigned long CRC32 for data
 */
unsigned long crc__CRC32(unsigned char const data[], unsigned long length)
{
	unsigned long crc = CRC_START_32;
	for (unsigned long a = 0; a < length; a = a+4)
	{
//		printf("CRC Hex: 0x%08lX \n", crc);
		crc = crc__CRC32U(crc, data[a+3]);
		crc = crc__CRC32U(crc, data[a+2]);
		crc = crc__CRC32U(crc, data[a+1]);
		crc = crc__CRC32U(crc, data[a+0]);
	}
	return (crc ^ 0xFFFFFFFF);
//	return (crc);
}


/* EoF */
